## main/Kconfig.projbuild
```kconfig
menu "Smart Knob Panel"

    config KNOB_MOTOR_ENABLE
        bool "启用电机驱动（FOC / 校准 / PWM 输出）"
        default n
        help
            总开关，默认关闭（调试屏幕/UI 时避免每次下载后电机自动运行）。
            关闭时：不初始化 FOC、不做电角度校准、不自动跑相位测试、
            不配置 LEDC/PWM，DRV8313 EN 始终拉低；MT6701 编码器照常读取，
            用手拧旋钮仍可在 UI 中导航（无力反馈），状态栏显示「电机已禁用」。
            打开后才会按原流程上电校准并输出力矩。

    config KNOB_SUPPLY_MV
        int "电机供电电压 VM (mV)"
        range 7000 12600
        default 12000
        help
            DRV8313 的 VM 实际电压（2S 锂电 7.4V … 12V 适配器）。
            必须与实物一致：设低了会让所有电压指令按 Vreal/Vset 放大，电流同比变大、发热。
            运行时也可用控制台 vsup <V> 临时修改。

    config KNOB_I_LIMIT_MA
        int "触感峰值电流上限 (mA，软件估算)"
        range 50 1000
        default 350
        help
            触感/锁角模式下 q 轴估算电流的硬上限。2804 额定 0.5A，默认 0.35A 留余量。

    config KNOB_I_RMS_LIMIT_MA
        int "持续(RMS)电流上限 (mA，热模型)"
        range 50 500
        default 200
        help
            I²t 热模型：估算 RMS 电流超过该值时自动按比例降低峰值上限。

    config KNOB_ALIGN_MV
        int "initFOC 对齐电压 Uq (mV，首档)"
        range 800 4000
        default 2000
        help
            仅上电校准约 2–3s 使用。2.0V/2.5Ω ≈ 0.8A。失败时自动按 +0.5V 升档重试，
            最高 KNOB_ALIGN_MAX_MV。电压太低 → 齿槽/摩擦卡住转子 → "Failed to notice movement"。

    config KNOB_ALIGN_MAX_MV
        int "initFOC 对齐电压上限 (mV)"
        range 800 4000
        default 3000
        help
            3.0V/2.5Ω ≈ 1.2A，仅短时，低于电机 2A 极限。

endmenu
```
